## main/Kconfig.projbuild
```kconfig
menu "Setup Wi-Fi"

    config ESP_WIFI_SSID
        string "WiFi SSID"
        default "ssid"
        help
            The "name" of the network.

    config ESP_WIFI_PASSWORD
        string "Wi-Fi password"
        default "minha_senha"
        help
            The password to connect with the network with the chosen SSID.
endmenu

menu "APIs credentials"

    config ESP_IPSTACK_KEY
        string "IP stack key"
        default ""
        help
            The "access_key" to use o access api.ipstack.com

    config ESP_OPENWEATHER_KEY
        string "Open Weather key"
        default ""
        help
            The "appid" to access api.openweathermap.org.

endmenu
```
